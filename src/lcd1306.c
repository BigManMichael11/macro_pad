/*
 * Copyright (c) 2019 Jan Van Winkel <jan.van_winkel@dxplore.eu>
 *
 * Based on ST7789V sample:
 * Copyright (c) 2019 Marc Reilly
 *
 * SPDX-License-Identifier: Apache-2.0
 */

#include <zephyr/kernel.h>

#ifndef LCD1306
#define LCD1306

#include <zephyr/logging/log.h>

#include <zephyr/device.h>
#include <zephyr/drivers/display.h>

#include "lcd1306.h"

LOG_MODULE_DECLARE(MacroPad);//KEEP THIS HERE, HAVE TO DECLARE LOGGING LEVEL


const uint8_t Arial_Narrow8x8[] = {
	0x00, 0x00, 0x00, 0x00, 0x00, 0x00, 0x00, 0x00,  // Code for char  
	0x00, 0xBF, 0x00, 0x00, 0x00, 0x00, 0x00, 0x00,  // Code for char !
	0x07, 0x00, 0x07, 0x00, 0x00, 0x00, 0x00, 0x00,  // Code for char "
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	0xFF, 0x81, 0xFF, 0x00, 0x00, 0x00, 0x00, 0x00   // Code for char 
};


#define char_w 8
#define char_h 8

const struct device *display_dev;


uint8_t *buf_empty;
struct display_buffer_descriptor empty_buf;
uint16_t empty_buf_size = 128*4*(sizeof(uint8_t));

uint8_t *all_char_buf;	
struct display_buffer_descriptor font_desc;



int clear_screen(){
	return display_write(display_dev,0,0,&empty_buf,buf_empty);
}


int print_char( const uint8_t col, const uint8_t row, const uint8_t c){
	return display_write(display_dev, col, row, &font_desc, &Arial_Narrow8x8[(c-32)*8]);
}

int print_str(const uint8_t col, const uint8_t row, const char *str, const uint8_t length){
	int r;
    for (int i = 0; i < length; i++){
		 r = print_char(col * char_w + i*char_w, row, str[i]);
        if(r != 0){
            //LOG_ERR("               FAILED TO WRITE CHAR %c", str[i]);
            return r;
        } else if(r == length - 1){
            return r;
        }
    }
    return r;
}






uint8_t lcd1306_init(){
    struct display_capabilities capabilities;

    
	display_dev = DEVICE_DT_GET(DT_CHOSEN(zephyr_display));
	if (!device_is_ready(display_dev)) {
		//LOG_ERR("Device %s not found. Aborting sample.", display_dev->name);
	}

    //LOG_INF("Display sample for %s", display_dev->name);
	display_get_capabilities(display_dev, &capabilities);



    empty_buf.buf_size = empty_buf_size;
	empty_buf.pitch = 128;//capabilities.x_resolution;
	empty_buf.width = 128;
	empty_buf.height = 32;


    font_desc.buf_size = char_w*char_h*sizeof(uint8_t);
	font_desc.pitch = char_w;//capabilities.x_resolution;
	font_desc.width = char_w;
	font_desc.height = char_h;


    
    buf_empty = k_malloc(128*4*sizeof(uint8_t));

    memset(buf_empty, 0, 128*4);

    int r = display_write(display_dev,0,0,&empty_buf,buf_empty);
    //LOG_INF("Display cleared");

    print_str(0, 0, "Hello World! ", 12);
    LOG_INF("Hello world written");


    return r;
}



#ifdef NEVER
int main(void)
{

	all_char_buf = k_malloc((127-32)*char_w*char_h*sizeof(uint8_t));

	size_t buf_size;
	struct display_buffer_descriptor empty_buf;
	struct display_capabilities capabilities;

	const struct device *display_dev;
	display_dev = DEVICE_DT_GET(DT_CHOSEN(zephyr_display));
	if (!device_is_ready(display_dev)) {
		LOG_ERR("Device %s not found. Aborting sample.", display_dev->name);
	}

	LOG_INF("Display sample for %s", display_dev->name);
	display_get_capabilities(display_dev, &capabilities);


	buf_size = 128*32*sizeof(uint8_t);

	empty_buf.buf_size = buf_size;
	empty_buf.pitch = 128;//capabilities.x_resolution;
	empty_buf.width = 128;
	empty_buf.height = 32;


	

	uint8_t *buf_empty;

	buf_empty = k_malloc(128*4*sizeof(uint8_t));
	

	memset(buf_empty, 0, 128*4);//128*32*sizeof(uint8_t));

/*
	const unsigned short yippe[] = {0x00, 0x00, 0x5F, 0x00, 0x5F, 0x00, 0x00, 0x00};
	for(int i = 0; i < 32; i++){
		for (int j = 0; j < 128; j++){
			buf_all[i*128+j] = 0x0u;//0xFFu;//(j % 2) * 0xFFu;
			if((i < 8) && (j < 8)){
				buf_all[i*128 + j] = ((yippe[j] & (1 << i)) >> i) * 0xFFu;
				k_msleep(5);
				//LOG_INF("i: %d j: %d val:%d",i, j, buf_all[i*128 + j]);
			}
		}
	}
*/
	
	font_desc.buf_size = char_w*char_h*sizeof(uint8_t);
	font_desc.pitch = char_w;//capabilities.x_resolution;
	font_desc.width = char_w;
	font_desc.height = char_h;



	display_write(display_dev,0,0,&empty_buf,buf_empty);

	int x = 0;
	int y = 0;

	bool lastWritten = 1;
	while (1) {
		//memset(buf, grey_count, buf_size);
		//display_write(display_dev, x, y, &empty_buf, lastWritten? buf : buf2);
		//display_write(display_dev, 0, 0, &empty_buf, buf_all);
		
		//print_char(display_dev, x, y, 'O');
		print_str(display_dev, x, y, "Hello World! ", 12);
		y = (y+16)%32;

		k_msleep(50);
	}
	return 0;
}
#endif



#endif